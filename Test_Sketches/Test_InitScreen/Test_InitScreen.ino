/* Test sketch for showing init display and debug menu

*/


#include <Arduino.h>
#include <U8g2lib.h>
#include <Wire.h>

// --- Ініціалізація дисплею ---
U8G2_SSD1306_128X64_NONAME_F_HW_I2C u8g2(U8G2_R0, /* reset=*/ U8X8_PIN_NONE);

// --- Піни ---
const int PIN_IR_FL = A0; 
const int PIN_IR_FR = A1; 
const int PIN_IR_BL = A6; // Analog Only
const int PIN_IR_BR = A7; // Analog Only

const int PIN_BTN = A2;   // Кнопка + Кінцевики
const int PIN_VOLT = A3;  

const int PIN_TRIG1 = 8;
const int PIN_ECHO1 = 9;

const int PIN_TRIG2 = 10;
const int PIN_ECHO2 = 11;

const int PIN_BUZZER = 12;

unsigned long last_screen_update = 0;

// --- НОТИ ---
#define NOTE_A3  220
#define NOTE_C4  262
#define NOTE_E4  330
#define NOTE_A4  440
#define NOTE_C5  523
#define NOTE_E5  659
#define NOTE_A5  880
#define NOTE_F3  175
#define NOTE_F4  349
#define NOTE_C6  1047

const unsigned char logo1[] PROGMEM = { 
  0x00, 0x00, 0x00, 0x00, 0x00, 0x00, 0x00, 0x00, 0x0e, 0x00, 0x00, 0x00, 0x00, 0x00, 0x00, 0x00, 
	0x00, 0x00, 0x00, 0x00, 0x00, 0x00, 0x00, 0x00, 0x1e, 0x00, 0x00, 0x00, 0x00, 0x00, 0x00, 0x00, 
	0x00, 0x02, 0x00, 0x00, 0x08, 0x00, 0x00, 0x00, 0x3e, 0x00, 0x00, 0x00, 0x00, 0x04, 0x00, 0x00, 
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	0x00, 0x00, 0x00, 0x00, 0x00, 0x00, 0x00, 0x70, 0x00, 0x00, 0x00, 0x00, 0x00, 0x00, 0x00, 0x00
};

const unsigned char logo2[] PROGMEM = { 
  0x00, 0x00, 0x00, 0x00, 0x00, 0x00, 0x00, 0x00, 0x00, 0x00, 0x00, 0x00, 0x00, 0x00, 0x00, 0x00, 
	0x00, 0x00, 0x00, 0x00, 0x00, 0x00, 0x00, 0x00, 0x00, 0x00, 0x00, 0x00, 0x00, 0x00, 0x00, 0x00, 
	0x00, 0x00, 0x00, 0x00, 0x00, 0x76, 0x00, 0x70, 0x00, 0x00, 0x00, 0x00, 0x00, 0x00, 0x00, 0x00, 
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	0x00, 0x00, 0x00, 0x00, 0x00, 0x00, 0x00, 0x00, 0x00, 0x00, 0x00, 0x00, 0x00, 0x00, 0x00, 0x00
};

const unsigned char logo3[] PROGMEM = { 
  0x00, 0x00, 0x00, 0x00, 0x00, 0x00, 0x00, 0x00, 0x00, 0x00, 0x00, 0x00, 0x00, 0x00, 0x00, 0x00, 
	0x00, 0x80, 0x03, 0x70, 0x00, 0x00, 0x00, 0x00, 0x00, 0x00, 0x00, 0x00, 0x00, 0x00, 0x00, 0x00, 
	0x00, 0xc0, 0x07, 0xf8, 0x00, 0x00, 0x00, 0x00, 0x00, 0x00, 0x00, 0x00, 0x00, 0x00, 0x00, 0x00, 
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	0x00, 0x00, 0x00, 0x00, 0x00, 0x00, 0x00, 0x00, 0x00, 0x00, 0x00, 0x00, 0x00, 0x00, 0x00, 0x00
};

// --- ФУНКЦІЇ ВІДОБРАЖЕННЯ (Щоб не дублювати код) ---
void drawBitmap(const unsigned char* bitmap) {
  u8g2.clearBuffer();
  u8g2.drawXBMP(0, 0, 128, 64, bitmap);
  u8g2.sendBuffer();
}

// --- НОВА КІБЕР-МЕЛОДІЯ ТА СИНХРОНІЗАЦІЯ ---
void play_intro_sequence() {
  // Техно-мелодія: швидке арпеджіо A-minor -> F-major
  // Всього 16 нот. Змінимо картинку рівно посередині (на 8-й ноті)
  
  int melody[] = {
    NOTE_A3, NOTE_C4, NOTE_E4, NOTE_A4,  // Частина 1
    NOTE_C5, NOTE_E5, NOTE_C5, NOTE_A4,  
    NOTE_F3, NOTE_A3, NOTE_C4, NOTE_F4,  // Частина 2 (зміна акорду)
    NOTE_A4, NOTE_C5, NOTE_A4, NOTE_F4
  };

  // Швидкість (менше = швидше)
  int noteDuration = 120; 

  for (int i = 0; i < 16; i++) {
    // === ЛОГІКА ПЕРЕМИКАННЯ ЕКРАНІВ ===
    // Якщо це самий початок -> малюємо Лого 1
    if (i == 0) {
      drawBitmap(logo1);
    }
    // Якщо дійшли до половини (8-ма нота) -> малюємо Лого 2
    // Музика при цьому не спиняється, бо малювання займає ~30мс, 
    // що менше паузи між нотами.
    else if (i == 8) {
      drawBitmap(logo2);
    }

    // === ГРАЄМО НОТУ ===
    tone(PIN_BUZZER, melody[i], noteDuration);
    // Пауза між нотами трохи більша за саму ноту, щоб вони не зливалися
    delay(noteDuration * 1.1); 
  }
}

void play_final_sound() {
  // Футуристичний звук "успішного завантаження"
  tone(PIN_BUZZER, NOTE_A4, 50); delay(60);
  tone(PIN_BUZZER, NOTE_A5, 50); delay(60);
  tone(PIN_BUZZER, NOTE_C6, 400); delay(400); 
}

// --- ДОПОМІЖНІ ФУНКЦІЇ ---
float get_voltage() {
  int raw = analogRead(PIN_VOLT);
  return (raw * 0.01015625); 
}

int get_sonar_dist(int trig, int echo) {
  digitalWrite(trig, LOW); delayMicroseconds(2);
  digitalWrite(trig, HIGH); delayMicroseconds(10);
  digitalWrite(trig, LOW);
  
  long duration = pulseIn(echo, HIGH, 12000); 
  if (duration == 0) return 999; 
  return duration * 0.034 / 2;
}

void drawBatteryIcon(int x, int y, float voltage) {
  u8g2.drawFrame(x, y, 22, 10);      
  u8g2.drawBox(x + 22, y + 2, 2, 6); 

  int fillWidth = 0;
  if (voltage >= 6.8) {
    fillWidth = map((long)(voltage * 100), 680, 840, 0, 18); 
    fillWidth = constrain(fillWidth, 0, 18);
  }

  if (fillWidth > 0) {
    u8g2.drawBox(x + 2, y + 2, fillWidth, 6);
  }

  if (voltage < 6.8) {
     u8g2.setFont(u8g2_font_profont11_tf); 
     u8g2.drawStr(x + 28, y + 8, "!"); 
  }
}

void setup() {
  u8g2.begin();
  
  pinMode(PIN_IR_FL, INPUT);
  pinMode(PIN_IR_FR, INPUT);
  pinMode(PIN_BTN, INPUT_PULLUP);
  pinMode(PIN_TRIG1, OUTPUT); 
  pinMode(PIN_ECHO1, INPUT);
  pinMode(PIN_TRIG2, OUTPUT); 
  pinMode(PIN_ECHO2, INPUT);
  pinMode(PIN_BUZZER, OUTPUT);

  // === ЕТАП 1 та 2: Логотипи під суцільну мелодію ===
  play_intro_sequence(); 
  
  delay(1000); // Невелика пауза після мелодії перед назвою

  // === ЕТАП 3: Назва ===
  drawBitmap(logo3);
  play_final_sound();
  delay(2000); 
}

void loop() {
  if (millis() - last_screen_update > 100) {
    last_screen_update = millis();

    float volt = get_voltage();
    int dist1 = get_sonar_dist(PIN_TRIG1, PIN_ECHO1);
    int dist2 = get_sonar_dist(PIN_TRIG2, PIN_ECHO2);
    
    bool ir_fl = analogRead(PIN_IR_FL) < 500;
    bool ir_fr = analogRead(PIN_IR_FR) < 500;
    bool ir_bl = analogRead(PIN_IR_BL) < 500;
    bool ir_br = analogRead(PIN_IR_BR) < 500;
    
    // 1 = натиснуто (перешкода), 0 = вільно
    bool bumpers_hit = !digitalRead(PIN_BTN); 

    u8g2.firstPage();
    do {
      // *** НОВИЙ ШРИФТ (Технічний, без засічок) ***
      u8g2.setFont(u8g2_font_profont11_tf); 
      
      // --- HEADER ---
      u8g2.setCursor(0, 8); 
      u8g2.print("Bat:"); u8g2.print(volt, 1); u8g2.print("v");
      drawBatteryIcon(85, 0, volt);
      u8g2.drawLine(0, 11, 128, 11); 

      // --- IR SENSORS ---
      u8g2.setCursor(0, 22);  u8g2.print("FL:"); u8g2.print(ir_fl);
      u8g2.setCursor(35, 22); u8g2.print("FR:"); u8g2.print(ir_fr);
      
      u8g2.setCursor(0, 32);  u8g2.print("BL:"); u8g2.print(ir_bl);
      u8g2.setCursor(35, 32); u8g2.print("BR:"); u8g2.print(ir_br);

      // --- BUMPERS (Спрощена індикація) ---
      u8g2.setCursor(75, 22); u8g2.print("Bumpers:");
      u8g2.setCursor(95, 32); 
      u8g2.print(bumpers_hit); // Друкує 0 або 1

      // --- SONARS ---
      u8g2.setCursor(0, 46);
      u8g2.print("Sonar 1: "); 
      if(dist1 == 999) u8g2.print("--"); else u8g2.print(dist1);
      u8g2.print("cm");

      u8g2.setCursor(0, 56);
      u8g2.print("Sonar 2: "); 
      if(dist2 == 999) u8g2.print("--"); else u8g2.print(dist2);
      u8g2.print("cm");

    } while (u8g2.nextPage());
  }
}